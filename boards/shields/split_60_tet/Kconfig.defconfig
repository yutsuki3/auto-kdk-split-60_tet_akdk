## boards/shields/split_60_tet/Kconfig.defconfig
```kconfig
if SHIELD_SPLIT_60_TET_LEFT

config ZMK_KEYBOARD_NAME
    default "split_60_tet"

endif

if SHIELD_SPLIT_60_TET_LEFT || SHIELD_SPLIT_60_TET_RIGHT

config ZMK_SPLIT
    default y

endif
```

## boards/shields/split_60_tet/Kconfig.shield
```kconfig
config SHIELD_SPLIT_60_TET_LEFT
    def_bool $(shields_list_contains,split_60_tet_left)
config SHIELD_SPLIT_60_TET_RIGHT
    def_bool $(shields_list_contains,split_60_tet_right)
```

## config/west.yml
```yaml
manifest:
  remotes:
    - name: zmkfirmware
      url-base: https://github.com/zmkfirmware
    - name: sekigon-gonnoc
      url-base: https://github.com/sekigon-gonnoc
  projects:
    - name: zmk
      remote: zmkfirmware
      revision: v0.2
      import: app/west.yml
  self:
    path: config
```
